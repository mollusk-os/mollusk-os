## FunKey/Config.in
```kconfig
source "$BR2_EXTERNAL_FUNKEY_PATH/package/fkgpiod/Config.in"
source "$BR2_EXTERNAL_FUNKEY_PATH/package/retrofe/Config.in"
source "$BR2_EXTERNAL_FUNKEY_PATH/package/dmtx-utils/Config.in"
source "$BR2_EXTERNAL_FUNKEY_PATH/package/ProdScreens/Config.in"
source "$BR2_EXTERNAL_FUNKEY_PATH/package/fonts-droid/Config.in"
source "$BR2_EXTERNAL_FUNKEY_PATH/package/libini/Config.in"
source "$BR2_EXTERNAL_FUNKEY_PATH/package/libopk/Config.in"
source "$BR2_EXTERNAL_FUNKEY_PATH/package/libxdgmime/Config.in"
source "$BR2_EXTERNAL_FUNKEY_PATH/package/gmenu2x/Config.in"
source "$BR2_EXTERNAL_FUNKEY_PATH/package/fluidlite/Config.in"
source "$BR2_EXTERNAL_FUNKEY_PATH/package/libmikmod/Config.in"
source "$BR2_EXTERNAL_FUNKEY_PATH/package/commander/Config.in"
source "$BR2_EXTERNAL_FUNKEY_PATH/package/bibi/Config.in"
source "$BR2_EXTERNAL_FUNKEY_PATH/package/picoarch/Config.in"
source "$BR2_EXTERNAL_FUNKEY_PATH/package/clock/Config.in"
source "$BR2_EXTERNAL_FUNKEY_PATH/package/st-sdl/Config.in"
source "$BR2_EXTERNAL_FUNKEY_PATH/package/eduke32/Config.in"

menu "Libretro cores"
source "$BR2_EXTERNAL_FUNKEY_PATH/package/libretro-ecwolf/Config.in"
source "$BR2_EXTERNAL_FUNKEY_PATH/package/libretro-fake08/Config.in"
source "$BR2_EXTERNAL_FUNKEY_PATH/package/libretro-fbalpha2012/Config.in"
source "$BR2_EXTERNAL_FUNKEY_PATH/package/libretro-fceumm/Config.in"
source "$BR2_EXTERNAL_FUNKEY_PATH/package/libretro-gambatte/Config.in"
source "$BR2_EXTERNAL_FUNKEY_PATH/package/libretro-gpsp/Config.in"
source "$BR2_EXTERNAL_FUNKEY_PATH/package/libretro-mame2000/Config.in"
source "$BR2_EXTERNAL_FUNKEY_PATH/package/libretro-mednafen-lynx/Config.in"
source "$BR2_EXTERNAL_FUNKEY_PATH/package/libretro-mednafen-ngp/Config.in"
source "$BR2_EXTERNAL_FUNKEY_PATH/package/libretro-mednafen-pce-fast/Config.in"
source "$BR2_EXTERNAL_FUNKEY_PATH/package/libretro-mednafen-wswan/Config.in"
source "$BR2_EXTERNAL_FUNKEY_PATH/package/libretro-pcsx-rearmed/Config.in"
source "$BR2_EXTERNAL_FUNKEY_PATH/package/libretro-picodrive/Config.in"
source "$BR2_EXTERNAL_FUNKEY_PATH/package/libretro-pokemini/Config.in"
source "$BR2_EXTERNAL_FUNKEY_PATH/package/libretro-prboom/Config.in"
source "$BR2_EXTERNAL_FUNKEY_PATH/package/libretro-snes9x2005/Config.in"
source "$BR2_EXTERNAL_FUNKEY_PATH/package/libretro-tyrquake/Config.in"
source "$BR2_EXTERNAL_FUNKEY_PATH/package/libretro-vitaquake2/Config.in"
endmenu
```

## FunKey/package/eduke32/Config.in
```kconfig
config BR2_PACKAGE_EDUKE32
	bool "eduke32"
	default y
	select BR2_PACKAGE_SDL
	select BR2_PACKAGE_SDL_MIXER
	select BR2_PACKAGE_LIBMIKMOD
	select BR2_PACKAGE_LIBOGG
	help
	  Duke Nukem 3D port for the FunKey S, packaged as an OPK
	  with the shareware episode.

	  https://github.com/mollusk-os/eduke32
```

## FunKey/package/libretro-ecwolf/Config.in
```kconfig
config BR2_PACKAGE_LIBRETRO_ECWOLF
	bool "libretro-ecwolf"
	default y
	depends on BR2_PACKAGE_PICOARCH
	help
	  Wolfenstein 3D engine (ECWolf) core for picoarch.

	  https://github.com/libretro/ecwolf
```

## FunKey/package/libretro-fake08/Config.in
```kconfig
config BR2_PACKAGE_LIBRETRO_FAKE08
	bool "libretro-fake08"
	default y
	depends on BR2_PACKAGE_PICOARCH
	help
	  PICO-8 emulator (FAKE-08) core for picoarch.

	  https://github.com/jtothebell/fake-08
```

## FunKey/package/libretro-fbalpha2012/Config.in
```kconfig
config BR2_PACKAGE_LIBRETRO_FBALPHA2012
	bool "libretro-fbalpha2012"
	default y
	depends on BR2_PACKAGE_PICOARCH
	help
	  Arcade emulator (Final Burn Alpha 2012) core for picoarch.

	  https://github.com/libretro/fbalpha2012
```

## FunKey/package/libretro-fceumm/Config.in
```kconfig
config BR2_PACKAGE_LIBRETRO_FCEUMM
	bool "libretro-fceumm"
	default y
	depends on BR2_PACKAGE_PICOARCH
	help
	  NES emulator (FCEUmm) core for picoarch.

	  https://github.com/libretro/libretro-fceumm
```

## FunKey/package/libretro-gambatte/Config.in
```kconfig
config BR2_PACKAGE_LIBRETRO_GAMBATTE
	bool "libretro-gambatte"
	default y
	depends on BR2_PACKAGE_PICOARCH
	help
	  Game Boy / Game Boy Color emulator (Gambatte) core for picoarch.

	  https://github.com/libretro/gambatte-libretro
```

## FunKey/package/libretro-gpsp/Config.in
```kconfig
config BR2_PACKAGE_LIBRETRO_GPSP
	bool "libretro-gpsp"
	default y
	depends on BR2_PACKAGE_PICOARCH
	help
	  Game Boy Advance emulator (gpSP) core for picoarch.

	  https://github.com/libretro/gpsp
```

## FunKey/package/libretro-mame2000/Config.in
```kconfig
config BR2_PACKAGE_LIBRETRO_MAME2000
	bool "libretro-mame2000"
	default y
	depends on BR2_PACKAGE_PICOARCH
	help
	  Arcade emulator (MAME 2000) core for picoarch.

	  https://github.com/libretro/mame2000-libretro
```

## FunKey/package/libretro-mednafen-lynx/Config.in
```kconfig
config BR2_PACKAGE_LIBRETRO_MEDNAFEN_LYNX
	bool "libretro-mednafen-lynx"
	default y
	depends on BR2_PACKAGE_PICOARCH
	help
	  Atari Lynx emulator (Beetle Lynx) core for picoarch.

	  https://github.com/libretro/beetle-lynx-libretro
```

## FunKey/package/libretro-mednafen-ngp/Config.in
```kconfig
config BR2_PACKAGE_LIBRETRO_MEDNAFEN_NGP
	bool "libretro-mednafen-ngp"
	default y
	depends on BR2_PACKAGE_PICOARCH
	help
	  Neo Geo Pocket emulator (Beetle NeoPop) core for picoarch.

	  https://github.com/libretro/beetle-ngp-libretro
```

## FunKey/package/libretro-mednafen-pce-fast/Config.in
```kconfig
config BR2_PACKAGE_LIBRETRO_MEDNAFEN_PCE_FAST
	bool "libretro-mednafen-pce-fast"
	default y
	depends on BR2_PACKAGE_PICOARCH
	help
	  PC Engine / TurboGrafx-16 emulator (Beetle PCE Fast) core for picoarch.

	  https://github.com/libretro/beetle-pce-fast-libretro
```

## FunKey/package/libretro-mednafen-wswan/Config.in
```kconfig
config BR2_PACKAGE_LIBRETRO_MEDNAFEN_WSWAN
	bool "libretro-mednafen-wswan"
	default y
	depends on BR2_PACKAGE_PICOARCH
	help
	  WonderSwan emulator (Beetle WonderSwan) core for picoarch.

	  https://github.com/libretro/beetle-wswan-libretro
```

## FunKey/package/libretro-pcsx-rearmed/Config.in
```kconfig
config BR2_PACKAGE_LIBRETRO_PCSX_REARMED
	bool "libretro-pcsx-rearmed"
	default y
	depends on BR2_PACKAGE_PICOARCH
	help
	  PlayStation emulator (PCSX ReARMed) core for picoarch.

	  https://github.com/libretro/pcsx_rearmed
```

## FunKey/package/libretro-picodrive/Config.in
```kconfig
config BR2_PACKAGE_LIBRETRO_PICODRIVE
	bool "libretro-picodrive"
	default y
	depends on BR2_PACKAGE_PICOARCH
	help
	  Master System / Genesis / 32X emulator (PicoDrive) core for picoarch.

	  https://github.com/libretro/picodrive
```

## FunKey/package/libretro-pokemini/Config.in
```kconfig
config BR2_PACKAGE_LIBRETRO_POKEMINI
	bool "libretro-pokemini"
	default y
	depends on BR2_PACKAGE_PICOARCH
	help
	  Pokemon Mini emulator (PokeMini) core for picoarch.

	  https://github.com/libretro/pokemini
```

## FunKey/package/libretro-prboom/Config.in
```kconfig
config BR2_PACKAGE_LIBRETRO_PRBOOM
	bool "libretro-prboom"
	default y
	depends on BR2_PACKAGE_PICOARCH
	help
	  Doom engine (PrBoom) core for picoarch.

	  https://github.com/mollusk-os/libretro-prboom
```

## FunKey/package/libretro-snes9x2005/Config.in
```kconfig
config BR2_PACKAGE_LIBRETRO_SNES9X2005
	bool "libretro-snes9x2005"
	default y
	depends on BR2_PACKAGE_PICOARCH
	help
	  SNES emulator (Snes9x 2005) core for picoarch.

	  https://github.com/libretro/snes9x2005
```

## FunKey/package/libretro-tyrquake/Config.in
```kconfig
config BR2_PACKAGE_LIBRETRO_TYRQUAKE
	bool "libretro-tyrquake"
	default y
	depends on BR2_PACKAGE_PICOARCH
	help
	  Quake engine (TyrQuake) core for picoarch.

	  https://github.com/mollusk-os/tyrquake
```

## FunKey/package/libretro-vitaquake2/Config.in
```kconfig
config BR2_PACKAGE_LIBRETRO_VITAQUAKE2
	bool "libretro-vitaquake2"
	default y
	depends on BR2_PACKAGE_PICOARCH
	help
	  Quake II engine (vitaQuake II) core for picoarch.

	  https://github.com/mollusk-os/vitaquake2
```
