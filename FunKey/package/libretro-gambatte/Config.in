## FunKey/package/libretro-gambatte/Config.in
```kconfig
# SPDX-License-Identifier: GPL-2.0-or-later
config BR2_PACKAGE_LIBRETRO_GAMBATTE
	bool "libretro-gambatte"
	default y
	depends on BR2_PACKAGE_PICOARCH
	help
	  Game Boy / Game Boy Color emulator (Gambatte) core for picoarch.

	  https://github.com/libretro/gambatte-libretro
```

## FunKey/package/libretro-gpsp/Config.in
```kconfig
# SPDX-License-Identifier: GPL-2.0-or-later
config BR2_PACKAGE_LIBRETRO_GPSP
	bool "libretro-gpsp"
	default y
	depends on BR2_PACKAGE_PICOARCH
	help
	  Game Boy Advance emulator (gpSP) core for picoarch.

	  https://github.com/libretro/gpsp
```

## FunKey/package/libretro-mednafen-wswan/Config.in
```kconfig
# SPDX-License-Identifier: GPL-2.0-or-later
config BR2_PACKAGE_LIBRETRO_MEDNAFEN_WSWAN
	bool "libretro-mednafen-wswan"
	default y
	depends on BR2_PACKAGE_PICOARCH
	help
	  WonderSwan emulator (Beetle WonderSwan) core for picoarch.

	  https://github.com/libretro/beetle-wswan-libretro
```

## FunKey/package/libretro-picodrive/Config.in
```kconfig
# SPDX-License-Identifier: GPL-2.0-or-later
config BR2_PACKAGE_LIBRETRO_PICODRIVE
	bool "libretro-picodrive"
	default y
	depends on BR2_PACKAGE_PICOARCH
	help
	  Master System / Genesis / 32X emulator (PicoDrive) core for picoarch.

	  https://github.com/libretro/picodrive
```

## FunKey/package/libretro-pokemini/Config.in
```kconfig
# SPDX-License-Identifier: GPL-2.0-or-later
config BR2_PACKAGE_LIBRETRO_POKEMINI
	bool "libretro-pokemini"
	default y
	depends on BR2_PACKAGE_PICOARCH
	help
	  Pokemon Mini emulator (PokeMini) core for picoarch.

	  https://github.com/libretro/pokemini
```

## FunKey/package/libretro-prboom/Config.in
```kconfig
# SPDX-License-Identifier: GPL-2.0-or-later
config BR2_PACKAGE_LIBRETRO_PRBOOM
	bool "libretro-prboom"
	default y
	depends on BR2_PACKAGE_PICOARCH
	help
	  Doom engine (PrBoom) core for picoarch.

	  https://github.com/mollusk-os/libretro-prboom
```
